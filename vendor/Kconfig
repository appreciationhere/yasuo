## vendor/Kconfig
```kconfig
rsource  "component/Kconfig"
rsource  "drivers/Kconfig"
rsource  "service/Kconfig"
rsource  "frameworks/board/Kconfig"
rsource  "frameworks/system/Kconfig"
```

## vendor/apps/Kconfig
```kconfig
menu "APPS"

config CMD_SDRAM_TEST
    bool "cmd shell to sdram test"
    default n

endmenu
```

## vendor/drivers/Kconfig
```kconfig
menu "DRIVERS"

config SDRAM_W9825G6KH
    bool "board sdram w9825g6kh"
    default n
config UART_TTY
    bool "board use uart tty"
    default n

endmenu
```

## vendor/frameworks/board/Kconfig
```kconfig
menu "FRAMEWORKS BOARD"


choice
    prompt "Select Board Platform"
    default STM32H750
config STM32H750
    bool "Board STM32H750"
config STM32F4XX
    bool "Board STM32F4XX"
endchoice

if STM32H750 || STM32F4XX
    config STM32_HAL
        bool "use stm32 hal lib"
        default n
endif

if STM32H750
config STM32H750_ART_PI
    bool "Board STM32H750_ART_PI"
endif
endmenu
```
